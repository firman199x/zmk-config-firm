#include <physical_layouts.dtsi>

/ {
    dactyl_manuform_layout: dactyl_manuform_layout {
        compatible = "zmk,physical-layout";
        display-name = "6x7";

        keys  //                     w   h    x    y
            = <&key_physical_attrs 100 100    0    0>
            , <&key_physical_attrs 100 100  100    0>
            , <&key_physical_attrs 100 100  200    0>
            , <&key_physical_attrs 100 100  300    0>
            , <&key_physical_attrs 100 100  400    0>
            , <&key_physical_attrs 100 100  500    0>
            , <&key_physical_attrs 100 100  600    0>
            , <&key_physical_attrs 100 100    0  100>
            , <&key_physical_attrs 100 100  100  100>
            , <&key_physical_attrs 100 100  200  100>
            , <&key_physical_attrs 100 100  300  100>
            , <&key_physical_attrs 100 100  400  100>
            , <&key_physical_attrs 100 100  500  100>
            , <&key_physical_attrs 100 100  600  100>
            , <&key_physical_attrs 100 100    0  200>
            , <&key_physical_attrs 100 100  100  200>
            , <&key_physical_attrs 100 100  200  200>
            , <&key_physical_attrs 100 100  300  200>
            , <&key_physical_attrs 100 100  400  200>
            , <&key_physical_attrs 100 100  500  200>
            , <&key_physical_attrs 100 100  600  200>
            , <&key_physical_attrs 100 100    0  300>
            , <&key_physical_attrs 100 100  100  300>
            , <&key_physical_attrs 100 100  200  300>
            , <&key_physical_attrs 100 100  300  300>
            , <&key_physical_attrs 100 100  400  300>
            , <&key_physical_attrs 100 100  500  300>
            , <&key_physical_attrs 100 100  600  300>
            , <&key_physical_attrs 100 100    0  400>
            , <&key_physical_attrs 100 100  100  400>
            , <&key_physical_attrs 100 100  200  400>
            , <&key_physical_attrs 100 100  300  400>
            , <&key_physical_attrs 100 100  400  400>
            , <&key_physical_attrs 100 100  500  400>
            , <&key_physical_attrs 100 100  600  400>
            , <&key_physical_attrs 100 100    0  500>
            , <&key_physical_attrs 100 100  100  500>
            , <&key_physical_attrs 100 100  200  500>
            , <&key_physical_attrs 100 100  300  500>
            , <&key_physical_attrs 100 100  400  500>
            , <&key_physical_attrs 100 100  500  500>
            , <&key_physical_attrs 100 100  600  500>
            , <&key_physical_attrs 100 100  800    0>
            , <&key_physical_attrs 100 100  900    0>
            , <&key_physical_attrs 100 100 1000    0>
            , <&key_physical_attrs 100 100 1100    0>
            , <&key_physical_attrs 100 100 1200    0>
            , <&key_physical_attrs 100 100 1300    0>
            , <&key_physical_attrs 100 100 1400    0>
            , <&key_physical_attrs 100 100  800  100>
            , <&key_physical_attrs 100 100  900  100>
            , <&key_physical_attrs 100 100 1000  100>
            , <&key_physical_attrs 100 100 1100  100>
            , <&key_physical_attrs 100 100 1200  100>
            , <&key_physical_attrs 100 100 1300  100>
            , <&key_physical_attrs 100 100 1400  100>
            , <&key_physical_attrs 100 100  800  200>
            , <&key_physical_attrs 100 100  900  200>
            , <&key_physical_attrs 100 100 1000  200>
            , <&key_physical_attrs 100 100 1100  200>
            , <&key_physical_attrs 100 100 1200  200>
            , <&key_physical_attrs 100 100 1300  200>
            , <&key_physical_attrs 100 100 1400  200>
            , <&key_physical_attrs 100 100  800  300>
            , <&key_physical_attrs 100 100  900  300>
            , <&key_physical_attrs 100 100 1000  300>
            , <&key_physical_attrs 100 100 1100  300>
            , <&key_physical_attrs 100 100 1200  300>
            , <&key_physical_attrs 100 100 1300  300>
            , <&key_physical_attrs 100 100 1400  300>
            , <&key_physical_attrs 100 100  800  400>
            , <&key_physical_attrs 100 100  900  400>
            , <&key_physical_attrs 100 100 1000  400>
            , <&key_physical_attrs 100 100 1100  400>
            , <&key_physical_attrs 100 100 1200  400>
            , <&key_physical_attrs 100 100 1300  400>
            , <&key_physical_attrs 100 100 1400  400>
            , <&key_physical_attrs 100 100  800  500>
            , <&key_physical_attrs 100 100  900  500>
            , <&key_physical_attrs 100 100 1000  500>
            , <&key_physical_attrs 100 100 1100  500>
            , <&key_physical_attrs 100 100 1200  500>
            , <&key_physical_attrs 100 100 1300  500>
            , <&key_physical_attrs 100 100 1400  500>
        ;
    };
};
